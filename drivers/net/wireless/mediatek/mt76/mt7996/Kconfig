## drivers/net/wireless/mediatek/mt76/mt7996/Kconfig
```kconfig
# SPDX-License-Identifier: BSD-3-Clause-Clear
config MT7996E
	tristate "MediaTek MT7996 (PCIe) support"
	select MT76_CONNAC_LIB
	select WANT_DEV_COREDUMP
	select RELAY
	depends on MAC80211
	depends on PCI
	help
	  This adds support for MT7996-based PCIe wireless devices,
	  which support concurrent tri-band operation at 6GHz, 5GHz,
	  and 2.4GHz IEEE 802.11be 4x4:4SS 4096-QAM, 320MHz channels.

	  To compile this driver as a module, choose M here.

config MT7996E_EXT_BSSID_STAS
	bool "Enable EXT_BSSID stations for mt7996 driver"
	default n
	depends on MT7996E
	help
	  Since the combined-phy rework of the driver, station links
	  allocated with these MUAR indices have not worked. Without
	  this enabled, these links will be disabled, and the interface
	  configurations will be updated accordingly.
```
